## boards/shields/ext_flash/Kconfig.defconfig
```kconfig
if SHIELD_EXT_FLASH

# Name must be less than 16 characters long!
config ZMK_KEYBOARD_NAME
    default "ext_flash"

endif
```

## boards/shields/ext_flash/Kconfig.shield
```kconfig
# No whitespace after the comma or in your keyboard name!
config SHIELD_EXT_FLASH
    def_bool $(shields_list_contains,ext_flash)
```

## boards/shields/imptest/Kconfig.defconfig
```kconfig
if SHIELD_IMP

# Name must be less than 16 characters long!
config ZMK_KEYBOARD_NAME
    default "IMPTEST"

endif

choice ST7789V_PIXEL_FORMAT
	default ST7789V_RGB565
endchoice

config LV_Z_VDB_SIZE
    default 100

config LV_Z_MEM_POOL_SIZE
    default 32768

config LV_DPI_DEF
    default 261

config LV_Z_BITS_PER_PIXEL
	default 16

choice LV_COLOR_DEPTH
	default LV_COLOR_DEPTH_16
endchoice

config LV_COLOR_16_SWAP
	default y

config LV_DISP_DEF_REFR_PERIOD
    default 20

choice LV_FONT_DEFAULT
    default LV_FONT_DEFAULT_MONTSERRAT_20
endchoice
```
